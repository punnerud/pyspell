## demo/esp32-tailscale-pyspell/sdkconfig.defaults
```kconfig
# T-Dongle S3 has 16 MB flash
CONFIG_ESPTOOLPY_FLASHSIZE_16MB=y

# Custom partition table with a large (8 MB) app partition. esp-idf-sys resolves
# a relative custom filename against the generated build dir, so an ABSOLUTE path
# is required here. Update this if the project directory moves.
CONFIG_PARTITION_TABLE_CUSTOM=y
CONFIG_PARTITION_TABLE_CUSTOM_FILENAME="/Users/punnerud/Downloads/pyspell/demo/esp32-tailscale-pyspell/partitions.csv"

# Give the main task a comfortable stack (TLS handshake for the /key fetch and
# the Noise crypto need a lot of stack).
CONFIG_ESP_MAIN_TASK_STACK_SIZE=24000

# Route the console (and our log output) to the native USB-Serial-JTAG, which is
# what the T-Dongle S3 exposes over USB. Without this, logs go to UART0 (GPIO43)
# and are invisible over the USB cable.
CONFIG_ESP_CONSOLE_USB_SERIAL_JTAG=y

# TLS root certificate bundle, so the one-shot HTTPS GET /key to
# controlplane.tailscale.com works out of the box.
CONFIG_MBEDTLS_CERTIFICATE_BUNDLE=y
CONFIG_MBEDTLS_CERTIFICATE_BUNDLE_DEFAULT_FULL=y

# IGMP for mDNS multicast (join 224.0.0.251) — used by the mdns-forward reflector.
CONFIG_LWIP_IGMP=y

# IP forwarding + NAPT for the subnet-router / exit-node data path (esp_netif_napt_enable).
# Compiled in for all builds; inactive unless a forwarding netif is created + NAPT enabled.
CONFIG_LWIP_IP_FORWARD=y
CONFIG_LWIP_IPV4_NAPT=y

# Performance: run the Xtensa cores at max 240 MHz (~1.5x the 160 MHz default —
# WireGuard ChaCha/Poly is pure-software and CPU-bound) and give UDP a deeper RX
# queue so bursts aren't dropped before our data-plane decrypts them.
CONFIG_ESP_DEFAULT_CPU_FREQ_MHZ_240=y
CONFIG_LWIP_UDP_RECVMBOX_SIZE=64

# No Bluetooth in this project — leave BT disabled to free RAM/flash.

# --- PySpell RAM-tuning pass (step 2): trade WG throughput for free heap ---
# We only send small HTTPS requests, so a 4 KB outgoing TLS record buffer is
# plenty. IN is left at the 16 KB default so large server records and the
# tailscale control-plane TLS keep working (cutting IN risks breaking fetch).
CONFIG_MBEDTLS_SSL_OUT_CONTENT_LEN=4096
# Fewer WiFi buffers for a low-traffic node + drop the AMPDU reorder buffers.
CONFIG_ESP_WIFI_STATIC_RX_BUFFER_NUM=4
CONFIG_ESP_WIFI_DYNAMIC_RX_BUFFER_NUM=8
CONFIG_ESP_WIFI_DYNAMIC_TX_BUFFER_NUM=8
CONFIG_ESP_WIFI_AMPDU_TX_ENABLED=n
CONFIG_ESP_WIFI_AMPDU_RX_ENABLED=n
# Shallower lwIP queues (we raised UDP mbox to 64 for throughput; 16 frees RAM).
CONFIG_LWIP_UDP_RECVMBOX_SIZE=16
CONFIG_LWIP_TCP_RECVMBOX_SIZE=16
# Raise the socket pool (default 10) so the parallel PySpell LAN pool has sockets
# beyond what tailscale (DERP/control/UDP/mDNS) holds — the real ceiling on
# simultaneous connections. 16 is the esp-idf max.
CONFIG_LWIP_MAX_SOCKETS=16
```

## firmware/esp32s3/sdkconfig.defaults
```kconfig
# T-Dongle S3 has 16 MB flash.
CONFIG_ESPTOOLPY_FLASHSIZE_16MB=y

# Custom partition table (esp-idf-sys needs an ABSOLUTE path here). Update if the
# project directory moves.
CONFIG_PARTITION_TABLE_CUSTOM=y
CONFIG_PARTITION_TABLE_CUSTOM_FILENAME="/Users/punnerud/Downloads/pyspell/firmware/esp32s3/partitions.csv"

# Comfortable main-task stack for the tree-walk evaluator.
CONFIG_ESP_MAIN_TASK_STACK_SIZE=16000

# Route the console (stdin/stdout) to the native USB-Serial-JTAG that the
# T-Dongle S3 exposes over USB — this is the live PySpell push channel.
CONFIG_ESP_CONSOLE_USB_SERIAL_JTAG=y

# Run the cores at 240 MHz.
CONFIG_ESP_DEFAULT_CPU_FREQ_MHZ_240=y
```
